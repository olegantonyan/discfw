## Config.in
```kconfig
menu "Snowsky Disc"
source "$BR2_EXTERNAL_DISC_PATH/package/disc-stock-blobs/Config.in"
source "$BR2_EXTERNAL_DISC_PATH/package/lvgl/Config.in"
source "$BR2_EXTERNAL_DISC_PATH/package/libdisc/Config.in"
source "$BR2_EXTERNAL_DISC_PATH/package/discd/Config.in"
source "$BR2_EXTERNAL_DISC_PATH/package/discsys/Config.in"
source "$BR2_EXTERNAL_DISC_PATH/package/discui/Config.in"
endmenu
```

## configs/disc_defconfig
```kconfig
BR2_mipsel=y
BR2_mips_32r5=y
# BR2_MIPS_SOFT_FLOAT is not set
BR2_MIPS_FP32_MODE_64=y
BR2_MIPS_ENABLE_NAN_2008=y
BR2_DL_DIR="$(BR2_EXTERNAL_DISC_PATH)/dl"
BR2_CCACHE=y
BR2_GLOBAL_PATCH_DIR="$(BR2_EXTERNAL_DISC_PATH)/patches/packages"
BR2_TARGET_OPTIMIZATION="-ffp-contract=off"
BR2_TOOLCHAIN_BUILDROOT_UCLIBC=y
BR2_TOOLCHAIN_BUILDROOT_WCHAR=y
BR2_KERNEL_HEADERS_VERSION=y
BR2_DEFAULT_KERNEL_VERSION="4.4.302"
BR2_PACKAGE_HOST_LINUX_HEADERS_CUSTOM_4_4=y
BR2_TOOLCHAIN_BUILDROOT_CXX=y
BR2_TARGET_GENERIC_HOSTNAME="disc"
BR2_TARGET_GENERIC_ISSUE="discfw"
BR2_ROOTFS_DEVICE_CREATION_DYNAMIC_MDEV=y
# BR2_TARGET_GENERIC_GETTY is not set
# BR2_TARGET_GENERIC_REMOUNT_ROOTFS_RW is not set
BR2_SYSTEM_DHCP=""
BR2_ROOTFS_OVERLAY="$(BR2_EXTERNAL_DISC_PATH)/board/disc/rootfs-overlay"
BR2_ROOTFS_POST_BUILD_SCRIPT="$(BR2_EXTERNAL_DISC_PATH)/board/disc/post-build.sh"
BR2_ROOTFS_POST_IMAGE_SCRIPT="$(BR2_EXTERNAL_DISC_PATH)/board/disc/post-image.sh"
BR2_PACKAGE_BUSYBOX_CONFIG_FRAGMENT_FILES="$(BR2_EXTERNAL_DISC_PATH)/board/disc/busybox.fragment"
BR2_PACKAGE_ALSA_UTILS=y
BR2_PACKAGE_ALSA_UTILS_AMIXER=y
BR2_PACKAGE_ALSA_UTILS_APLAY=y
BR2_PACKAGE_ALSA_UTILS_SPEAKER_TEST=y
BR2_PACKAGE_MPD=y
BR2_PACKAGE_MPD_FLAC=y
BR2_PACKAGE_MPD_LIBSNDFILE=y
# BR2_PACKAGE_MPD_MAD is not set
BR2_PACKAGE_MPD_MPG123=y
BR2_PACKAGE_MPD_OPUS=y
BR2_PACKAGE_MPD_VORBIS=y
BR2_PACKAGE_MPD_TCP=y
BR2_PACKAGE_MPD_MPC=y
BR2_PACKAGE_DEJAVU=y
# BR2_PACKAGE_DEJAVU_MONO is not set
# BR2_PACKAGE_DEJAVU_SERIF is not set
# BR2_PACKAGE_DEJAVU_SANS_CONDENSED is not set
# BR2_PACKAGE_DEJAVU_SERIF_CONDENSED is not set
BR2_PACKAGE_BUSYBOX_SHOW_OTHERS=y
BR2_PACKAGE_EVTEST=y
BR2_PACKAGE_I2C_TOOLS=y
BR2_PACKAGE_LIBMPDCLIENT=y
BR2_PACKAGE_LRZSZ=y
BR2_TARGET_ROOTFS_SQUASHFS=y
BR2_TARGET_ROOTFS_SQUASHFS_BS_128K=y
BR2_TARGET_ROOTFS_SQUASHFS4_LZO=y
# BR2_TARGET_ROOTFS_TAR is not set
BR2_PACKAGE_DISC_STOCK_BLOBS=y
BR2_PACKAGE_LVGL=y
BR2_PACKAGE_DISCD=y
BR2_PACKAGE_DISCSYS=y
BR2_PACKAGE_DISCUI=y
BR2_PACKAGE_IW=y
BR2_PACKAGE_WPA_SUPPLICANT=y
BR2_PACKAGE_WPA_SUPPLICANT_CLI=y
BR2_PACKAGE_BRCM_PATCHRAM_PLUS=y
BR2_PACKAGE_BLUEZ5_UTILS=y
BR2_PACKAGE_BLUEZ5_UTILS_CLIENT=y
BR2_PACKAGE_BLUEZ5_UTILS_DEPRECATED=y
BR2_PACKAGE_MPD_LIBSOXR=y
BR2_PACKAGE_MPD_FFMPEG=y
BR2_PACKAGE_FFMPEG=y
# BR2_PACKAGE_FFMPEG_FFMPEG is not set
BR2_PACKAGE_FFMPEG_ENCODERS=""
BR2_PACKAGE_FFMPEG_DECODERS="aac aac_fixed alac ape wavpack wmav1 wmav2 wmalossless wmapro tta"
BR2_PACKAGE_FFMPEG_MUXERS=""
BR2_PACKAGE_FFMPEG_DEMUXERS="mov aac ape wv asf matroska tta"
BR2_PACKAGE_FFMPEG_PARSERS="aac aac_latm"
BR2_PACKAGE_FFMPEG_BSFS=""
BR2_PACKAGE_FFMPEG_PROTOCOLS="file"
BR2_PACKAGE_FFMPEG_FILTERS=""
# BR2_PACKAGE_FFMPEG_INDEVS is not set
# BR2_PACKAGE_FFMPEG_OUTDEVS is not set
BR2_PACKAGE_JPEG=y
BR2_PACKAGE_JPEG_TURBO=y
BR2_PACKAGE_LIBPNG=y
BR2_PACKAGE_BLUEZ5_UTILS_TOOLS=y
BR2_PACKAGE_DROPBEAR=y
BR2_PACKAGE_GESFTPSERVER=y
BR2_PACKAGE_MDNSD=y
BR2_PACKAGE_MDNSD_MQUERY=y
BR2_PACKAGE_BLUEZ_ALSA=y
BR2_PACKAGE_LIBOPENAPTX=y
BR2_PACKAGE_WPA_SUPPLICANT_DEBUG_SYSLOG=y
BR2_PACKAGE_DROPBEAR_DISABLE_REVERSEDNS=y
```

## package/disc-stock-blobs/Config.in
```kconfig
config BR2_PACKAGE_DISC_STOCK_BLOBS
	bool "disc-stock-blobs"
	help
	  From FiiO's official V2.57 OTA (downloaded, decrypted, sha256
	  checked): the stock GPL kernel modules and the radio firmware,
	  installed to the target; the stock kernel (xImage) and the
	  stock rootfs padded to 96 MiB (for disc-flash stock), installed
	  to the images directory. Nothing of it is kept in this tree.
```

## package/discd/Config.in
```kconfig
config BR2_PACKAGE_DISCD
	bool "discd"
	select BR2_PACKAGE_ALSA_LIB
	select BR2_PACKAGE_LIBDISC
	help
	  CS43131 DAC control daemon, discctl CLI and the ALSA "disc"
	  hook PCM that sets DAC rate and mute.
```

## package/discsys/Config.in
```kconfig
config BR2_PACKAGE_DISCSYS
	bool "discsys"
	depends on BR2_USE_WCHAR # libglib2
	depends on BR2_TOOLCHAIN_HAS_THREADS # libglib2
	depends on BR2_USE_MMU # libglib2
	select BR2_PACKAGE_LIBDISC
	select BR2_PACKAGE_LIBGLIB2
	select BR2_PACKAGE_LIBMPDCLIENT
	help
	  System daemon: keys, screen power, power profiles, settings,
	  output policy, Bluetooth/Wi-Fi management, modes. CLI discfw.
```

## package/discui/Config.in
```kconfig
config BR2_PACKAGE_DISCUI
	bool "discui"
	depends on BR2_TOOLCHAIN_HAS_THREADS
	select BR2_PACKAGE_LVGL
	select BR2_PACKAGE_LIBMPDCLIENT
	select BR2_PACKAGE_LIBDISC
	select BR2_PACKAGE_JPEG
	select BR2_PACKAGE_LIBPNG
	select BR2_PACKAGE_ZLIB
	help
	  Player UI (LVGL, MPD client): folders, playlists, library,
	  now playing, settings, lock screen.
```

## package/libdisc/Config.in
```kconfig
config BR2_PACKAGE_LIBDISC
	bool "libdisc"
	help
	  Shared discfw code: settings store and schema, line protocol,
	  key=value encoding, natural sort.
```

## package/lvgl/Config.in
```kconfig
config BR2_PACKAGE_LVGL
	bool "lvgl"
	depends on BR2_TOOLCHAIN_HAS_THREADS
	help
	  LVGL graphics library, static, configured for Linux fbdev
	  and evdev (board lv_conf.h).

	  https://lvgl.io
```
